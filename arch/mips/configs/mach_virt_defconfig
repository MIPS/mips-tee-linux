## arch/mips/configs/mach_virt_defconfig
```kconfig
CONFIG_MIPS_VIRT=y
CONFIG_BLK_DEV_INITRD=y
CONFIG_BLK_DEV_RAM=y
# CONFIG_KEYBOARD_ATKBD is not set
# CONFIG_MOUSE_PS2 is not set
# CONFIG_SERIO is not set
CONFIG_VIRTIO_CONSOLE=y
CONFIG_VIRTIO_MMIO=y
CONFIG_EXT4_FS=y
CONFIG_EXT4_FS_POSIX_ACL=y
CONFIG_EXT4_FS_SECURITY=y
```

## drivers/tee/mipstee/Kconfig
```kconfig
# MIPS-TEE Trusted Execution Environment Configuration
config MIPSTEE
	tristate "MIPS-TEE"
	depends on MIPS
	help
	  This implements the MIPS-TEE Trusted Execution Environment (TEE)
	  driver.
```
